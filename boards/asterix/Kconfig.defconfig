## boards/bangle2/Kconfig
```kconfig
# SPDX-FileCopyrightText: 2026 Core Devices LLC
# SPDX-License-Identifier: Apache-2.0

config BOARD_BANGLE2
    bool
    default y

config BANGLE2_TEST_NO_WDT_STARTUP_FEED
    bool "TEST ONLY: skip the startup HW-watchdog feeds (Renode honesty RED test)"
    default n
    help
      When set, main() does NOT issue the early watchdog_feed() before
      rtc_init(), and the RTC COMPARE_1 interrupt does NOT call
      task_watchdog_startup_feed(). This produces a dedicated RED-test ELF
      that MUST fail the Renode early-RR0-feed honesty check: with the
      startup feeds removed, no CPU write reaches NRF_WDT->RR[0] in the
      early boot window. Never enable in a shipping build.

config WATCHDOG_SELF_ARM
    bool
    default y if BOARD_BANGLE2
    help
      Bare-metal full-flash boards have no bootloader to arm the hardware
      watchdog. When set, main() arms the driver's own WDT (nrf5.c: 8 s,
      RR0) early in boot, immediately before rtc_init.

config BANGLE2_TEST_NO_WDT_ARM
    bool "TEST ONLY: skip the boot-time WDT self-arm (Renode honesty RED test)"
    default n
    help
      When set, main() does NOT call watchdog_init()/watchdog_start(), so
      the hardware watchdog is never armed. This produces a dedicated
      RED-test ELF that MUST fail the Renode wdt_arm honesty check: no CPU
      write reaches NRF_WDT->TASKS_START and RUNSTATUS stays 0 after boot.
      Never enable in a shipping build.
```

## src/fw/drivers/display/Kconfig
```kconfig
# SPDX-FileCopyrightText: 2026 Core Devices LLC
# SPDX-License-Identifier: Apache-2.0

menuconfig DISPLAY
    bool "Display"
    help
      Display Drivers

if DISPLAY

config DISPLAY_JDI_SF32LB
    bool "JDI (SiFli SF32LB)"
    default y if SOC_SF32LB52
    select HAL_SIFLI_LCD
    help
      Support for JDI display via SiFli SF32LB.

config DISPLAY_SHARP_LS013B7DH01_NRF5
    bool "Sharp LS013B7DH01 (nRF5)"
    default y if SOC_NRF52 && !BOARD_BANGLE2
    help
      Support for the Sharp LS013B7DH01 display via nRF5.

config DISPLAY_LPM013M126_NRF5
    bool "JDI LPM013M126 (nRF5)"
    default y if BOARD_BANGLE2
    help
      Support for the JDI LPM013M126 memory-in-pixel color LCD via nRF5
      (Bangle.js 2). The system UI renders at the FLINT 144x168 mono
      geometry and the driver letterboxes onto the 176x176 panel.

config DISPLAY_QEMU
    bool "QEMU Framebuffer Display"
    default y if SOC_QEMU
    help
      Support for the QEMU framebuffer display peripheral.

module = DRIVER_DISPLAY
module-str = Display
source "subsys/logging/Kconfig.template.log_level"

endif # DISPLAY
```

## src/fw/drivers/flash/Kconfig
```kconfig
# SPDX-FileCopyrightText: 2026 Core Devices LLC
# SPDX-License-Identifier: Apache-2.0

menuconfig FLASH
    bool "Flash"
    help
      Flash Drivers

if FLASH

config FLASH_GD25LQ255E
    bool "GigaDevice GD25LQ255E"
    help
      Support for the GigaDevice GD25LQ255E NOR flash.

config FLASH_GD25Q256E
    bool "GigaDevice GD25Q256E"
    help
      Support for the GigaDevice GD25Q256E NOR flash.

config FLASH_BANGLE2
    bool "Bangle.js 2 8 MB SPI NOR"
    help
      Support for the Bangle.js 2 (SMA-Q3) 8 MB dual-IO SPI NOR flash. The
      concrete part is not named in the source; a generic dual-IO opcode set
      is used.

config FLASH_QEMU
    bool "QEMU External Flash"
    default y if SOC_QEMU
    help
      Support for the QEMU external flash peripheral.

module = DRIVER_FLASH
module-str = Flash
source "src/fw/Kconfig.template.log_level"

endif # FLASH
```

## src/fw/drivers/hrm/Kconfig
```kconfig
# SPDX-FileCopyrightText: 2026 Core Devices LLC
# SPDX-License-Identifier: Apache-2.0

menuconfig HRM
    bool "Heart Rate Monitor"
    help
      Heart Rate Monitor Drivers

if HRM

config HRM_GH3X2X
    bool "Goodix GH3X2X"
    help
      Support for the Goodix GH3X2X heart rate sensor.

config HRM_VC31
    bool "Vcare VC31/VC31B"
    help
      Interface-only support for the Vcare VC31/VC31B optical heart-rate sensor.
      Powers the part and reads raw registers; the PPG->BPM algorithm is a
      proprietary blob and is not implemented.

config HRM_STUB
    bool "Stub"
    help
      Stub heart rate monitor implementation.

module = DRIVER_HRM
module-str = Heart Rate Monitor
source "src/fw/Kconfig.template.log_level"

endif # HRM
```

## src/fw/drivers/pressure/Kconfig
```kconfig
# SPDX-FileCopyrightText: 2026 Core Devices LLC
# SPDX-License-Identifier: Apache-2.0

menuconfig PRESSURE
    bool "Pressure Sensor"
    help
      Pressure Sensor Drivers

if PRESSURE

choice PRESSURE_DRIVER
    prompt "Pressure Sensor Driver"

config PRESSURE_BMP390
    bool "Bosch BMP390"
    help
      Support for the Bosch BMP390 barometric pressure sensor.

config PRESSURE_BMP280
    bool "Bosch BMP280"
    help
      Support for the Bosch BMP280 barometric pressure sensor.

endchoice

module = DRIVER_PRESSURE
module-str = Pressure Sensor
source "src/fw/Kconfig.template.log_level"

endif # PRESSURE
```

## src/fw/services/touch/Kconfig
```kconfig
# SPDX-FileCopyrightText: 2026 Core Devices LLC
# SPDX-License-Identifier: Apache-2.0

config SERVICE_TOUCH
    bool "Touch"
    default y if TOUCH
    help
      Touch event service. Requires a touch driver (CONFIG_TOUCH).

if SERVICE_TOUCH

config TOUCH_NAV_BUTTONS
    bool "Synthesize navigation buttons from touch gestures"
    default n
    help
      Translate touchscreen gestures into synthetic Pebble button events so the
      button-driven UI can be navigated by touch on devices with fewer than the
      four buttons PebbleOS assumes: swipe up/down -> UP/DOWN (scroll menus),
      tap -> SELECT (activate). The synthetic events are injected into the normal
      kernel button pipeline, so the launcher, menus and watchface all respond
      without any app-level changes. Intended for boards with a touchscreen but
      a reduced button count (e.g. Bangle.js 2).

module = SERVICE_TOUCH
module-str = Touch
source "subsys/logging/Kconfig.template.log_level"

endif
```
